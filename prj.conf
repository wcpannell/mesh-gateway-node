## CMakeLists.txt
```
cmake_minimum_required(VERSION 3.20.0)

#find_package(Zephyr REQUIRED HINTS $ENV{ZEPHYR_BASE})
find_package(Zephyr REQUIRED HINTS ..)
project(client)

target_sources(app PRIVATE
	src/main.c
	src/model_handler.c
	src/msg.c)
target_include_directories(app PRIVATE include)
```

## prj.conf
```kconfig
#
# Copyright (c) 2020 Nordic Semiconductor ASA
#
# SPDX-License-Identifier: LicenseRef-Nordic-5-Clause
#
CONFIG_NCS_SAMPLES_DEFAULTS=y

# General configuration
# CONFIG_MAIN_STACK_SIZE=4096
# CONFIG_SYSTEM_WORKQUEUE_STACK_SIZE=4096
CONFIG_FLASH=y
CONFIG_FLASH_PAGE_LAYOUT=y
CONFIG_FLASH_MAP=y
CONFIG_NVS=y
CONFIG_SETTINGS=y
CONFIG_HWINFO=y
CONFIG_DK_LIBRARY=y
CONFIG_PRINTK=y  #needed?

# Bluetooth configuration
CONFIG_BT=y
CONFIG_BT_COMPANY_ID=0x0059
CONFIG_BT_DEVICE_NAME="Mesh Sensor Gateway"
#CONFIG_BT_DEVICE_NAME="Mesh Sensor Observer"
CONFIG_BT_L2CAP_TX_MTU=69
CONFIG_BT_L2CAP_TX_BUF_COUNT=32
CONFIG_BT_OBSERVER=y
CONFIG_BT_PERIPHERAL=y
CONFIG_BT_SETTINGS=y

# Disable unused Bluetooth features
CONFIG_BT_CTLR_DUP_FILTER_LEN=0
CONFIG_BT_CTLR_LE_ENC=n
CONFIG_BT_DATA_LEN_UPDATE=n
CONFIG_BT_PHY_UPDATE=n
CONFIG_BT_CTLR_CHAN_SEL_2=n
CONFIG_BT_CTLR_MIN_USED_CHAN=n
CONFIG_BT_CTLR_PRIVACY=n

# Bluetooth mesh configuration
CONFIG_BT_MESH=y
CONFIG_BT_MESH_RELAY=y
CONFIG_BT_MESH_FRIEND=y
CONFIG_BT_MESH_ADV_BUF_COUNT=64
CONFIG_BT_MESH_TX_SEG_MAX=32
CONFIG_BT_MESH_RX_SEG_MAX=16
CONFIG_BT_MESH_PB_GATT=y
CONFIG_BT_MESH_PB_ADV=y
CONFIG_BT_MESH_GATT_PROXY=y
CONFIG_BT_MESH_DK_PROV=y
CONFIG_BT_DEBUG_LOG=y

# Bluetooth mesh models
CONFIG_BT_MESH_SENSOR_CLI=y

# USB Uart
CONFIG_STDOUT_CONSOLE=y
CONFIG_LOG=y
CONFIG_SERIAL=y
CONFIG_UART_INTERRUPT_DRIVEN=y
CONFIG_UART_LINE_CTRL=y

# USB Device
CONFIG_USB=y
CONFIG_USB_DEVICE_STACK=y
CONFIG_USB_DEVICE_PRODUCT="Mesh Sensor Gateway"
CONFIG_USB_CDC_ACM=y

# CONFIG_USB_DEVICE_LOG_LEVEL_ERR=y
# CONFIG_USB_DRIVER_LOG_LEVEL_ERR=y

# debug provisioning?
#CONFIG_BT_LOG_LEVEL_DBG=y

# use Zephyr's BTLE controller, recommended http://developer.nordicsemi.com/nRF_Connect_SDK_dev/doc/PR-4304/nrf/ug_bt_mesh_configuring.html
CONFIG_BT_LL_SW_SPLIT=y
```

## src/main.c
```c
/*
 * Copyright (c) 2020 Nordic Semiconductor ASA
 *
 * SPDX-License-Identifier: LicenseRef-Nordic-5-Clause
 */

/** @file
 *  @brief Nordic mesh sensor observer sample
 */
#include "model_handler.h"
#include "msg.h"
#include <bluetooth/bluetooth.h>
#include <bluetooth/mesh/dk_prov.h>
#include <bluetooth/mesh/models.h>
#include <device.h>
#include <dk_buttons_and_leds.h>
#include <drivers/hwinfo.h>
#include <drivers/uart.h>
#include <errno.h>
#include <kernel.h>
#include <settings/settings.h>
#include <sys/ring_buffer.h>
#include <usb/usb_device.h>
#include <zephyr.h>

// Define & initialize event_msgq, written to by model_handler, read from
// irq
K_MSGQ_DEFINE(event_msgq, sizeof(struct msg_pub_payload), 16, 4);

// UART buffers
RING_BUF_DECLARE(tx_buf, 256);
RING_BUF_DECLARE(rx_buf, 256);

// Interrupt Service Routine
static void interrupt_handler(const struct device *dev, void *user_data)
{
	// struct serial_data *dev_data = user_data;

	while (uart_irq_update(dev) && uart_irq_is_pending(dev)) {
		if (uart_irq_rx_ready(dev)) {
			// just printk anything received for now.
			// TODO: impl receive message handling.
			uint8_t buf[16];
			size_t read;
			read = uart_fifo_read(dev, buf, sizeof(buf));
			if (read) {
				printk("USB UART Rx %u Bytes: ", read);
				for (int i = 0; i < read; i++) {
					printk("%x", buf[i]);
				}
				printk("\n");
			}

			// Re-enable TX irq
			// Assume USB-UART can do bidirectional. Not disabling, so don't need to
			// enable
			// uart_irq_tx_enable(dev);
		}

		if (uart_irq_tx_ready(dev)) {
			uint8_t *buf;
			size_t len;
			size_t wrote = 0;

			len = ring_buf_get_claim(&tx_buf, &buf, 16); // 16 is just a nice size
			if (!len) {
				printk("USB Tx Queue Empty!\n");
				uart_irq_tx_disable(dev);
			} else {
				wrote = uart_fifo_fill(dev, buf, len);
				printk("USB UART Tx sent %u Bytes\n", wrote);
			}
			ring_buf_get_finish(&tx_buf, wrote);
		}
	}
}

static void bt_ready(int err)
{
	if (err) {
		printk("Bluetooth init failed (err %d)\n", err);
		return;
	}

	printk("Bluetooth initialized\n");

	dk_leds_init();
	dk_buttons_init(NULL);

	err = bt_mesh_init(bt_mesh_dk_prov_init(), model_handler_init());
	if (err) {
		printk("Initializing mesh failed (err %d)\n", err);
		return;
	}

	if (IS_ENABLED(CONFIG_SETTINGS)) {
		settings_load();
	}

	printk("Mesh already provisioned? %d\n", bt_mesh_is_provisioned());

	/* This will be a no-op if settings_load() loaded provisioning info */
	printk("Retval of bt_mesh_prov_enable: %d\n",
	       bt_mesh_prov_enable(BT_MESH_PROV_ADV | BT_MESH_PROV_GATT));

	printk("Mesh initialized\n");
}

struct device *usb_uart_dev;

struct k_work_delayable uart_handler_work;
void uart_handler(struct k_work *work)
{
	// "idle" loop
	// TODO: implement a means to receive a NACK
	// TODO: implement a means to resend if receive a NACK
	size_t serbuf_wrote;
	struct message event_message = {
		.type = MSG_PUB,
		.payload_size = MSG_PUB_PAYLOAD_SIZE,
		.payload = NULL,
	};
	struct msg_pub_payload payload;
	uint8_t msg_buf[MSG_PUB_BUF_SIZE];
	uint32_t dtr;

	// Make sure there's something on the line before trying to Tx
	// USB CDC ACM is not happy unless there's someone on the line.
	uart_line_ctrl_get(usb_uart_dev, UART_LINE_CTRL_DTR, &dtr);
	if (dtr) {
		// send event
		if (k_msgq_num_used_get(&event_msgq)) {
			k_msgq_get(&event_msgq, &payload, K_MSEC(100));
			printk("Got Payload from %x: %x = %u\n", payload.addr, payload.property_id,
			       payload.value);
			event_message.payload = &payload;

			serbuf_wrote = msg_serialize(&event_message, msg_buf, MSG_PUB_BUF_SIZE);
			if (serbuf_wrote != MSG_PUB_BUF_SIZE) {
				printk("Error Serializing Payload. Wrote %u bytes\n", serbuf_wrote);
				for (int i = 0; i < serbuf_wrote; i++) {
					printk("%X", msg_buf[i]);
				}
				printk("\n");
			}

			// push message to tx_buf
			serbuf_wrote = ring_buf_put(&tx_buf, msg_buf, MSG_PUB_BUF_SIZE);
			if (serbuf_wrote != MSG_PUB_BUF_SIZE) {
				printk("Error Pushing into tx_buf! considering handling this!\n");
			}

			// enable UART Tx IRQ, if was disabled, we have data to spit.
			uart_irq_tx_enable(usb_uart_dev);
		}
	} else {
		uart_irq_tx_disable(usb_uart_dev);
	}
	k_work_schedule(&uart_handler_work, K_MSEC(100));
}

void main(void)
{
	int err;

	printk("Initializing USB UART...\n");

	usb_uart_dev = device_get_binding("CDC_ACM_0");
	if (!usb_uart_dev) {
		printk("USB UART device CDC_ACM_0 not found!\n");
		printk("bailing out...\n");
		return;
	}

	if (usb_enable(NULL) != 0) {
		printk("Failed to enable USB\n");
		printk("bailing out...\n");
		return;
	}

	uart_irq_callback_set(usb_uart_dev, interrupt_handler);
	uart_irq_rx_enable(usb_uart_dev);
	k_work_init_delayable(&uart_handler_work, uart_handler);
	k_work_schedule(&uart_handler_work, K_NO_WAIT);

	printk("Initializing Bluetooth...\n");

	err = bt_enable(bt_ready);
	if (err) {
		printk("Bluetooth init failed (err %d)\n", err);
	}
}
```

## include/msg.h
```c
#ifndef _MSG_H
#define _MSG_H

#include <stddef.h>
#include <stdint.h>

// CRC8 polynomial is x8 + x5 + x4 + 1 = 0b0011_0001
#define MSG_CRC_POLY 0x31

// CRC8 IV is 0xff
#define MSG_CRC_IV 0xff

// Publish Event msg buffer is always 10 bytes
#define MSG_PUB_BUF_SIZE 10
#define MSG_PUB_PAYLOAD_SIZE 6

// Minimum size of packet is 4 bytes for 0-sized payload
#define MSG_BUF_MIN_SIZE 4

enum msg_errors {
  MSG_NO_ERROR = 0,
  MSG_ERR_STARTBYTE,
  MSG_ERR_CRC,
  MSG_ERR_LEN,
  MSG_ERR_NOIMPL,
};

enum msg_type {
  MSG_POLL = 0,    // NULL payload
  MSG_BACKLOG = 1, // uint8_t payload
  MSG_PUB = 1,     // struct msg_pub_payload
  MSG_ACK = 0xFE,  // NULL payload
  MSG_NACK = 0xFF, // NULL payload
};

struct message {
  enum msg_type type;
  size_t payload_size; // 255 max
  union {
    struct msg_pub_payload *payload;
    uint8_t value;
  };
};

struct msg_pub_payload {
  uint16_t addr;
  uint16_t property_id;
  uint16_t value; // Value is scaled 0.01, Temp or Humidity
};

/**
 * @brief Serialize a message
 *
 * Flattens the data structure and stuffs it into the byte buffer
 *
 * @param[in] msg message data structure
 * @param[out] buf existing byte buffer of sufficient length.
 * @param[in] len (maximum) length of the provided buffer.
 *
 * @returns number of bytes written into buf
 *
 * Serialized Message format:
 * byte: desc
 * 0: Start byte, always 0xAA for valid packets.
 * 1: Message Type, see enum msg_type.
 * 2: Payload Size, number of bytes in the payload.
 * 3 - (3+N-1): payload, Payload Size bytes long, interpretation varies
 *            by message type
 * 3+N: CRC8, uses the MSG_CRC_POLY polynomial and MSG_CRC_IV initial value
 */
size_t msg_serialize(const struct message *msg, uint8_t *buf, const size_t len);

/**
 * @brief Deserialize a message
 *
 * @param[in] buf byte buffer containing flat message data
 * @param[in] len length of buffer
 * @param[out] msg message data structure to be filled with buf data.
 *
 * @returns 0 on success
 */
int msg_deserialize(uint8_t *buf, size_t len, struct message *msg);

#endif
```

## src/model_handler.c
```c
/*
 * Copyright (c) 2020 Nordic Semiconductor ASA
 *
 * SPDX-License-Identifier: LicenseRef-Nordic-5-Clause
 */

#include "model_handler.h"
#include "msg.h"
#include <bluetooth/bluetooth.h>
#include <bluetooth/mesh/models.h>
#include <dk_buttons_and_leds.h>
#include <kernel.h>

#define GET_DATA_INTERVAL 3000

extern struct k_msgq event_msgq;

/**
 * @brief converts a received publish event into a message
 */
static void enqueue_event(const struct bt_mesh_msg_ctx *ctx,
			  const struct bt_mesh_sensor_type *sensor,
			  const struct sensor_value *value)
{
	uint16_t temp_value;
	// Just one event message needed, we'll immediately enqueue it
	struct msg_pub_payload event_payload;

	// Sender's address
	event_payload.addr = ctx->addr;

	// Sensor type
	event_payload.property_id = sensor->id;

	// Value is a "fixed position decimal"
	// e.g. 1234 = 12.34; 123456 = 1234.56
	temp_value = (uint16_t)(value->val1 * 100);
	temp_value += (uint16_t)((value->val2 / 10000) & 0xFFFF);
	event_payload.value = temp_value;

	// enqueue message
	k_msgq_put(&event_msgq, &event_payload, K_NO_WAIT);
	//printk("fake enqueue of %u = %u from %u\n", event_payload.property_id, event_payload.value,
	//       event_payload.addr);
}

static void sensor_cli_data_cb(struct bt_mesh_sensor_cli *cli, struct bt_mesh_msg_ctx *ctx,
			       const struct bt_mesh_sensor_type *sensor,
			       const struct sensor_value *value)
{
	switch (sensor->id) {
	case (0x0075): // bt_mesh_sensor_precise_present_amb_temp.id
		printk("Temperature update from %#4.4x! %s°C\n", ctx->addr,
		       bt_mesh_sensor_ch_str_real(value));
		enqueue_event(ctx, sensor, value);
		break;
	case (0x0076): // bt_mesh_sensor_present_amb_rel_humidity.id
		printk("Humidity Update from %#4.4x! %s\n", ctx->addr,
		       bt_mesh_sensor_ch_str_real(value));
		enqueue_event(ctx, sensor, value);
		break;
	default:
		printk("Unexpected. %x sensor with %u channels! %s\n", sensor->id,
		       sensor->channel_count, bt_mesh_sensor_ch_str_real(value));
	}
}

static void sensor_cli_series_entry_cb(struct bt_mesh_sensor_cli *cli, struct bt_mesh_msg_ctx *ctx,
				       const struct bt_mesh_sensor_type *sensor, uint8_t index,
				       uint8_t count,
				       const struct bt_mesh_sensor_series_entry *entry)
{
	printk("Relative runtime in %d to %d degrees: %s percent\n", entry->value[1].val1,
	       entry->value[2].val1, bt_mesh_sensor_ch_str_real(&entry->value[0]));
}

static const struct bt_mesh_sensor_cli_handlers bt_mesh_sensor_cli_handlers_1 = {
	.data = sensor_cli_data_cb,
	.series_entry = sensor_cli_series_entry_cb,
};

static struct bt_mesh_sensor_cli sensor_cli =
	BT_MESH_SENSOR_CLI_INIT(&bt_mesh_sensor_cli_handlers_1);

static struct k_work_delayable get_data_work;

// static struct bt_mesh_sensor_data sensors[2] = {
// 	{
// 		.type = &bt_mesh_sensor_precise_present_amb_temp,
// 		.value = { .val1 = 0, .val2 = 0 },
// 	},
// 	{ .type = &bt_mesh_sensor_present_amb_rel_humidity, .value = { .val1 =
// 0, .val2 = 0 } },
// };
uint32_t sensor_count = 3;

static void get_data(struct k_work *work)
{
	// int err;

	// handles read of found sensors with sensor_cli callback
	// err = bt_mesh_sensor_cli_all_get(&sensor_cli, NULL, NULL, &sensor_count);
	// printk("Found %u sensors\n", sensor_count);

	// if (err == 0) {
	// 	for (uint32_t i = 0; i < sensor_count; i++) {
	// 		printk("grabbed data of type %x, w/ val %s\n",
	// sensors[i].type->id,
	// bt_mesh_sensor_ch_str_real(sensors[i].value));
	// 	}
	// }

	k_work_schedule(&get_data_work, K_MSEC(GET_DATA_INTERVAL));
}

/* Set up a repeating delayed work to blink the DK's LEDs when attention is
 * requested.
 */
static struct k_work_delayable attention_blink_work;
static bool attention;

static void attention_blink(struct k_work *work)
{
	static int idx;
	const uint8_t pattern[] = {
		BIT(0) | BIT(1),
		BIT(1) | BIT(2),
		BIT(2) | BIT(3),
		BIT(3) | BIT(0),
	};

	if (attention) {
		dk_set_leds(pattern[idx++ % ARRAY_SIZE(pattern)]);
		k_work_reschedule(&attention_blink_work, K_MSEC(30));
	} else {
		dk_set_leds(DK_NO_LEDS_MSK);
	}
}

static void attention_on(struct bt_mesh_model *mod)
{
	attention = true;
	k_work_reschedule(&attention_blink_work, K_NO_WAIT);
}

static void attention_off(struct bt_mesh_model *mod)
{
	/* Will stop rescheduling blink timer */
	attention = false;
}

static const struct bt_mesh_health_srv_cb health_srv_cb = {
	.attn_on = attention_on,
	.attn_off = attention_off,
};

static struct bt_mesh_health_srv health_srv = {
	.cb = &health_srv_cb,
};

BT_MESH_HEALTH_PUB_DEFINE(health_pub, 0);

static struct bt_mesh_elem elements[] = {
	BT_MESH_ELEM(1,
		     BT_MESH_MODEL_LIST(BT_MESH_MODEL_CFG_SRV,
					BT_MESH_MODEL_HEALTH_SRV(&health_srv, &health_pub),
					BT_MESH_MODEL_SENSOR_CLI(&sensor_cli)),
		     BT_MESH_MODEL_NONE),
};

static const struct bt_mesh_comp comp = {
	.cid = CONFIG_BT_COMPANY_ID,
	.elem = elements,
	.elem_count = ARRAY_SIZE(elements),
};

const struct bt_mesh_comp *model_handler_init(void)
{
	k_work_init_delayable(&attention_blink_work, attention_blink);
	k_work_init_delayable(&get_data_work, get_data);

	k_work_schedule(&get_data_work, K_MSEC(GET_DATA_INTERVAL));

	return &comp;
}
```

## src/msg.c
```c
#include "msg.h"
#include <sys/crc.h>

/**
 * @brief get a "fresh" message from the MessageQueue
 */
struct message *msg_get_message;

/**
 * @brief return a message to the MessageQueue
 */

/**
 * @brief Serialize a struct msg_pub_payload
 *
 * @param[in] pub_payload to be serialized
 * @param[out] buf holds serialized data. Must be at least 6 bytes long.
 *
 * @returns size of flattened datastructure (fixed 6 bytes)
 *
 * Helper for msg_serialize that flattens the datastructure and stuffs it into
 * the byte buffer.
 */
static size_t pubpayload_tobuf(struct msg_pub_payload *pub_payload, uint8_t *buf)
{
	return 6;
}

size_t msg_serialize(const struct message *msg, uint8_t *buf, const size_t len)
{
	size_t crc_pos = 3; // assume 0-sized payload

	if (len < MSG_BUF_MIN_SIZE) {
		// too small to hold a message.
		return 0;
	}

	// Message Start bit
	buf[0] = 0xAA;
	buf[1] = (msg->type) & 0xff;
	buf[2] = (msg->payload_size) & 0xff;

	if (msg->type != MSG_PUB) {
		buf[3] = msg->value;
		crc_pos++;
	} else {
		buf[3] = (msg->payload->addr >> 8) & 0xff;
		buf[4] = msg->payload->addr & 0xff;
		buf[5] = (msg->payload->property_id >> 8) & 0xff;
		buf[6] = msg->payload->property_id & 0xff;
		buf[7] = (msg->payload->value >> 8) & 0xff;
		buf[8] = msg->payload->value & 0xff;
		crc_pos = 9;
	}

	buf[crc_pos] = crc8(buf, crc_pos, MSG_CRC_POLY, MSG_CRC_IV, false);
	return crc_pos + 1;
}

int msg_deserialize(uint8_t *buf, size_t len, struct message *msg)
{
	uint_fast8_t crc_pos = 3;

	if (len < MSG_BUF_MIN_SIZE) {
		// too small to hold a message.
		return MSG_ERR_LEN;
	}

	if (buf[0] != 0xAA) {
		return MSG_ERR_STARTBYTE;
	};
	msg->type = buf[1] & 0xff;
	msg->payload_size = buf[2] & 0xff;

	if (msg->type != MSG_PUB) {
		msg->value = buf[3];
	} else {
		// No need, we'll never deserialize this.
		crc_pos = 9;
		return MSG_ERR_NOIMPL; // not implemented
	}

	// Check CRC
	if (buf[crc_pos] != crc8(buf, len - 1, MSG_CRC_POLY, MSG_CRC_IV, false)) {
		return MSG_ERR_CRC; // bad CRC
	}

	return MSG_NO_ERROR;
}
```
